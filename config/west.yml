## config/west.yml
```yaml
manifest:
  remotes:
    - name: zmkfirmware
      url-base: https://github.com/gibbz00
  projects:
    - name: zmk
      remote: zmkfirmware
      revision: borne
      import: app/west.yml
  self:
    path: config
```
